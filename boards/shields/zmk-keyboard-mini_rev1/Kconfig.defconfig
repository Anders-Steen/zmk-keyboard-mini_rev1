## boards/shields/zmk-keyboard-mini_rev1/Kconfig.defconfig
```kconfig
if SHIELD_MINI_REV1

# Name must be less than 16 characters long!
config ZMK_KEYBOARD_NAME
    default "Mini rev1"

endif
```

## boards/shields/zmk-keyboard-mini_rev1/Kconfig.shield
```kconfig
# No whitespace after the comma or in your keyboard name!
config SHIELD_MINI_REV1
    def_bool $(shields_list_contains,mini_rev1)
```
